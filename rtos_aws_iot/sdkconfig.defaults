## rtos_aws_iot/sdkconfig.defaults
```kconfig
# newlib for ESP32 and ESP8266 platform

CONFIG_NEWLIB_ENABLE=y
CONFIG_NEWLIB_LIBRARY_LEVEL_NORMAL=y
CONFIG_NEWLIB_NANO_FORMAT=
CONFIG_SSL_USING_MBEDTLS=y
CONFIG_LWIP_IPV6=y

# Add backward compatibility for older FreeRTOS data types
CONFIG_FREERTOS_ENABLE_BACKWARD_COMPATIBILITY=y
```
